## firmware/anchor/main/Kconfig.projbuild
```kconfig
menu "UWB Anchor Configuration"

    choice UWB_ANCHOR_BOARD
        prompt "Target host board"
        default UWB_ANCHOR_BOARD_STAMPS3
        help
            Select which host board's pin definitions (boards/stamps3.h or
            boards/atoms3.h, at the repo root) main.cpp uses to configure
            uwb::Qm33120. The standard anchor build is M5StampS3A on a
            StampS3 BreakOut with the UWB module attached through a
            0.5mm 12P FPC to DIP adapter; AtomS3 is kept as an alternative
            for anyone who already has one. StampFly is a tag-only
            configuration (docs/IRQ_POLICY.md) and is intentionally not
            offered here.

        config UWB_ANCHOR_BOARD_STAMPS3
            bool "M5StampS3A (+ StampS3 BreakOut)"

        config UWB_ANCHOR_BOARD_ATOMS3
            bool "M5 AtomS3 (alternative)"

    endchoice

    choice UWB_BOARD_ATOMS3_PINOUT
        prompt "AtomS3 pin layout"
        depends on UWB_ANCHOR_BOARD_ATOMS3
        default UWB_BOARD_ATOMS3_PINOUT_A
        help
            Selects which of the two AtomS3 pin layouts boards/atoms3.h
            builds (docs/IRQ_POLICY.md). Layout A repurposes the Grove port
            (G1/G2) for RST/IRQ and wires a ToF sensor to the bottom header
            (G38/G39); recommended for the plain AtomS3, whose G38/G39 are
            shared with the onboard MPU6886 IMU. Layout B instead uses the
            bottom header (G38/G39) for RST/IRQ and plugs the ToF sensor
            straight into the Grove port; recommended for AtomS3R, whose
            G38/G39 have nothing else attached.

        config UWB_BOARD_ATOMS3_PINOUT_A
            bool "Layout A: RST/IRQ=Grove(G1/G2), ToF I2C=G38/G39 (hand-wired to bottom header)"

        config UWB_BOARD_ATOMS3_PINOUT_B
            bool "Layout B: RST/IRQ=G38/G39, ToF I2C=Grove(G1/G2) (plug-and-play)"

    endchoice

    choice UWB_ANCHOR_METHOD
        prompt "Ranging method"
        default UWB_ANCHOR_METHOD_DS
        help
            DS-TWR (double-sided, respondDSRange()): adds a Final exchange
            and a Result frame; distance is computed on this ANCHOR side and
            relayed back to the TAG. 本プロジェクトの本番運用では DS-TWR を
            優先する方針のため、既定値は DS-TWR とする。
            SS-TWR (single-sided, respondRange()): one Poll/Response
            exchange, distance is computed on the TAG side instead. TAG側も
            同じ方式を選ぶ必要がある。

        config UWB_ANCHOR_METHOD_DS
            bool "DS-TWR (default, production)"

        config UWB_ANCHOR_METHOD_SS
            bool "SS-TWR"

    endchoice

    config UWB_ANCHOR_SHORT_ADDR
        hex "自分のショートアドレスの初期値 (NVSが空のときに使う値)"
        range 0x0000 0xFFFE
        default 0x0002
        help
            このアンカー自身のTWRショートアドレスの **初期値**。

            起動時はまず NVS (components/uwb_cfgstore) を読み、保存された値が
            あればそちらを使う。NVSが空・未初期化・破損のいずれの場合も
            この値へフォールバックする。したがって何も設定しなければ
            従来どおりこの値でそのまま動く。

            実機5台に別々のアドレスを入れる作業は、ビルドをやり直すのではなく
            シリアルコンソール (UWB_ANCHOR_CONSOLE) から

                addr set 0x0003
                save

            で行うことを推奨する (docs/GETTING_STARTED.md §6)。
            0xFFFF はブロードキャストアドレスなので使わないこと。

    config UWB_ANCHOR_CONSOLE
        bool "シリアルコンソール (USB-Serial/JTAG) を有効にする"
        default y
        help
            有効にすると、起動時に ESP-IDF の console コンポーネント
            (linenoise + argtable3) による REPL を専用タスクで立ち上げ、
            USB 経由で次のコマンドを受け付ける。

                addr / addr set <hex> / save / reset-config / info / reboot

            測距ループとは別タスクで動き、ショートアドレスの変更は
            次の応答から反映される。

            無効にすると anchor_console.cpp 自体がビルド対象から外れ、
            console コンポーネントへの依存も消える。NVSに保存済みの
            アドレスで起動する機能だけは残るので、「コンソールで設定して
            save したあと、コンソールを無効にしたファームを焼く」運用も
            できる。

    choice UWB_TIMING_PROFILE
        prompt "TWR 遅延プリセット"
        default UWB_TIMING_PROFILE_POLLING_BOTH
        help
            docs/TIMING_PRESETS.md で確定した、役割(タグ/アンカー) × IRQ有無の
            組み合わせごとの遅延パラメータ一式（応答遅延・受信タイムアウト等）
            を切り替える。

            **タグとアンカーは必ず同じプリセットを選ぶこと。** 片側だけ変える
            と測距が成立しない。しかも症状は「距離が出ない」だけでどちらが
            悪いのかログからは分からないため、フレーム(Poll/Response)に
            版番号と種別を載せて相手と比較し、不一致なら警告する仕組みが
            入っている（測距自体は続行する。docs/TIMING_PRESETS.md §3）。

            この設定値は自動では変わらない。例えば AnchorIrq を選んでも
            pin_irq が未配線で待ちがポーリングへフォールバックした場合、
            遅延の値自体は変えず、起動ログで警告するだけになる
            （docs/TIMING_PRESETS.md §4(b)）。

        config UWB_TIMING_PROFILE_POLLING_BOTH
            bool "両側ポーリング（**既定**。850kbps向けに実機で検証済み。docs/HANDOFF.md §0-D）"

        config UWB_TIMING_PROFILE_ANCHOR_IRQ
            bool "アンカーのみ IRQ（約59Hz、6.8Mbps/128前提。850kbpsでは未検証・未再導出）"

        config UWB_TIMING_PROFILE_BOTH_IRQ
            bool "両側 IRQ（約90Hz、6.8Mbps/128前提。850kbpsでは未検証・未再導出）"

    endchoice

    config UWB_ENABLE_IRQ
        bool "IRQ を起床信号として使う（未配線なら自動でポーリングへフォールバック）"
        default y
        help
            IRQ（割り込み要求）を、受信を待つループの「起床信号」としてだけ
            使う。ステータスレジスタの判読・フレーム照合・エラー処理は
            IRQ有効/無効に関わらず完全に同一のポーリング経路を通る
            （dwt_setcallbacks()/dwt_isr()は使わない。docs/IRQ_POLICY.md）。

            **2026-08-22 に既定を y（有効）へ変更した。** 全ボード
            （M5StampS3A の G7、StampFly 背面 FPC の G16、AtomS3 の G2 または
            G38/G39）で pin_irq が配線されるようになり、IRQ を使わない構成が
            例外になったため。**ただし実機での極性検証はまだ済んでいない。**
            測距が全く成立しない場合は、まずこれを n に、遅延プリセットを
            PollingBoth に落として切り分けること（docs/IRQ_POLICY.md）。

            有効にしても pin_irq が未配線（M5StampS3A のうち IRQ を配線
            していない個体等）、または ISR 登録に失敗した場合は自動的に
            ポーリングへフォールバックする（`uwb::Qm33120::irqActive()` で
            実際に有効になったかを確認できる。起動ログにも出る）。
            ポーリング経路は常に第一級の実装として残っており、劣化版では
            ない。

    # --- docs/ARCHITECTURE_V2.md §2.1/§2.4: v2 event-driven Responder ---
    # `uwb_radio` タスク（uwb::Responder::service() を無限に回すだけの専用
    # タスク。電波の唯一の所有者）と、統計行・イベント行を出す main タスク
    # （コア0）の設定。2026-08-30 の再設計で測った事実: 旧
    # respondRange()/respondDSRange() ループにあった「Poll 待ち 200ms の
    # ホスト側窓」はこの Responder には存在しない（RXは無期限に有効のまま
    # - §1）。UWB_ANCHOR_IDLE_TICK_MS はその窓の代わりではなく、生存確認と
    # IRQ エッジ取りこぼしに対する保険としてだけ働く短い目覚まし間隔。

    config UWB_ANCHOR_RADIO_TASK_CORE
        int "Core the uwb_radio task (Responder::service() loop) is pinned to"
        range 0 1
        default 1
        help
            docs/ARCHITECTURE_V2.md §2.1: uwb_radio is the only task that
            ever touches the radio chip (owns it exclusively). Passed to
            xTaskCreatePinnedToCore(). Default 1 so the main task (stats
            line, console, LED - core 0) never shares a core with the
            radio's tight service() loop.

    config UWB_ANCHOR_RADIO_TASK_PRIO
        int "Priority of the uwb_radio task"
        range 1 24
        default 20
        help
            docs/ARCHITECTURE_V2.md §2.1. Kept high (above the console REPL
            and the main task) so RX handling and delayed-TX arming are
            never delayed by other duties sharing the same core.

    config UWB_ANCHOR_RADIO_TASK_STACK
        int "Stack size of the uwb_radio task [bytes]"
        range 4096 32768
        default 8192
        help
            Passed to xTaskCreatePinnedToCore(). The same call chain the old
            respondRange()/respondDSRange() loop used (frame build,
            delayed-TX arming, DS-TWR distance computation) now runs inside
            uwb::Responder::service() on this task instead. Unmeasured on
            real hardware yet - check the "uwb_radio task stack high-water
            mark" log line printed 5s after boot and raise this value if the
            free margin it reports is under roughly 2KB.

    config UWB_ANCHOR_RESTART_ON_FOREIGN_POLL
        bool "Restart the in-flight exchange when a DIFFERENT tag's Poll arrives during WaitFinal"
        default y
        help
            uwb::ResponderConfig::restartOnForeignPoll
            (docs/ARCHITECTURE_V2.md §2.2's "複数タグ" note). When y
            (default), a Poll from a tag other than the one this anchor is
            currently waiting on a Final from abandons the in-flight
            exchange and answers the new Poll instead (last-Poll-wins,
            matching the pre-v2 respondDSRange() behaviour of always
            restarting on any Poll). Set n to make WaitFinal ignore foreign
            Polls (absorbed and counted as "other") until the current
            exchange's own Final arrives or its deadline passes instead, if
            fairness between multiple simultaneous tags turns out to be a
            problem in practice.

            A Poll from the SAME tag this anchor is already exchanging with
            always restarts the exchange regardless of this setting (that is
            a retry, not contention between two different tags).

    config UWB_ANCHOR_IDLE_TICK_MS
        int "Idle wakeup interval while listening [ms]"
        range 1 1000
        default 20
        help
            uwb::ResponderConfig::idleTickMs. This is NOT a replacement for
            the old per-loop 200ms Poll-wait window that this v2 Responder
            removes entirely (RX now stays enabled indefinitely -
            docs/ARCHITECTURE_V2.md §1's "受信は無期限"). Its only two jobs
            are (1) a liveness check - re-enable RX if the chip is ever
            found not receiving when nothing else woke the task - and (2) a
            safety net against a missed IRQ edge: the IRQ line is
            level-driven while a status bit is set, but edge-triggered on
            the GPIO side, so an event landing between "read status" and
            "clear status" can lose its edge and never wake the task on its
            own. One extra SPI status read every 20ms while idle is
            negligible cost for that margin (see
            uwb_qm33120_responder_fsm.hpp's ResponderConfig::idleTickMs
            comment for the same reasoning in code).

    config UWB_ANCHOR_STATS_INTERVAL_MS
        int "Interval between \"type\":\"anchor_stats\" JSON lines [ms]"
        range 100 60000
        default 1000
        help
            docs/ARCHITECTURE_V2.md §2.5. The main task (core 0) prints
            uwb::Responder::snapshot() as one JSON line at this interval.
            This line REPLACES the old periodic "DS_RESP_STAT"/"SS_RESP_STAT"
            text log lines that firmware/anchor's pre-v2 main.cpp used to
            print every UWB_ANCHOR_METHOD success count (removed in v2 -
            see docs/GETTING_STARTED.md's anchor sections for the new
            format).

    config UWB_ANCHOR_LOG_EVENTS
        bool "Print a \"type\":\"range\" JSON line for every completed DS-TWR exchange"
        default n
        help
            docs/ARCHITECTURE_V2.md §2.1/§2.5. When y, the main task drains
            uwb::Responder::popEvent() and prints one JSON line per
            RangeEvent (peer address / sequence / distance / elapsed time),
            in addition to the periodic anchor_stats line. Off by default
            because a busy anchor can complete many exchanges per second and
            this is a per-event (not per-second) log volume; turn it on for
            close-in debugging of a specific run. SS-TWR never produces a
            RangeEvent (the anchor side does not compute the distance for
            SS-TWR), so this option has no visible effect when
            UWB_ANCHOR_METHOD_SS is selected.

endmenu
```

## firmware/devtest/main/Kconfig.projbuild
```kconfig
menu "UWB Devtest Configuration"

    choice UWB_DEVTEST_BOARD
        prompt "Target host board"
        default UWB_DEVTEST_BOARD_STAMPS3
        help
            Select which host board's pin definitions (boards/stamps3.h or
            boards/stampfly.h, at the repo root)
            main.cpp uses to configure uwb::Qm33120.

        config UWB_DEVTEST_BOARD_STAMPS3
            bool "M5StampS3A"

        config UWB_DEVTEST_BOARD_STAMPFLY
            bool "StampFly (M5StampS3A on drone, rear 12P FPC)"
            help
                M5StampS3A 背面に予約されている 12P FPC (0.5mm) 経由で
                接続する構成。SPI 4線に加えて RST / IRQ / WAKEUP がすべて
                取れる (boards/stampfly.h)。電源も同じコネクタの VDD_3V3
                から取るので降圧回路は要らない。
                旧 GROVE 4線構成は廃案 (2026-08-22)。

    endchoice

    choice UWB_DEVTEST_ROLE
        prompt "Device role"
        default UWB_DEVTEST_ROLE_SENDER
        help
            SENDER calls Qm33120::sendFrame() once a second. RECEIVER polls
            Qm33120::receiveFrame() in a loop. Flash one board as SENDER and
            a second board as RECEIVER (same PHY config, i.e. same defaults)
            to verify over-the-air connectivity end to end.

        config UWB_DEVTEST_ROLE_SENDER
            bool "Sender (periodic sendFrame)"

        config UWB_DEVTEST_ROLE_RECEIVER
            bool "Receiver (polling receiveFrame)"

    endchoice

endmenu
```

## firmware/probe/main/Kconfig.projbuild
```kconfig
menu "UWB Probe Configuration"

    choice UWB_PROBE_BOARD
        prompt "Target host board"
        default UWB_PROBE_BOARD_STAMPS3
        help
            Select which host board's pin definitions (boards/stamps3.h or
            boards/stampfly.h, at the repo root) main.c uses to configure
            uwb_port.

        config UWB_PROBE_BOARD_STAMPS3
            bool "M5StampS3A"

        config UWB_PROBE_BOARD_STAMPFLY
            bool "StampFly (M5StampS3A on drone, rear 12P FPC)"
            help
                M5StampS3A 背面に予約されている 12P FPC (0.5mm) 経由で
                接続する構成。SPI 4線に加えて RST / IRQ / WAKEUP がすべて
                取れる (boards/stampfly.h)。電源も同じコネクタの VDD_3V3
                から取るので降圧回路は要らない。
                旧 GROVE 4線構成は廃案 (2026-08-22)。

    endchoice

    config UWB_SPI_FAST_HZ
        int "SPI fast clock override [Hz] (0 = use boards/*.h default)"
        range 0 32000000
        default 0
        help
            Overrides cfg.spi_fast_hz after it has been populated from
            boards/*.h's BOARD_*_UWB_PORT_CONFIG. The default, 0, leaves
            it untouched - i.e. exactly the boards/*.h value (currently
            16 MHz), identical to the behaviour before this option
            existed.

            Useful for bisecting a Device ID that cannot be read, or that
            reads back intermittently corrupted, by lowering the SPI
            clock. The QM33120W/DW3720 SPI clock ceiling is 32 MHz.

    config UWB_PROBE_TEST_WAKEUP
        bool "L10: exercise the WAKEUP pin (sleep -> WAKEUP pulse -> verify)"
        default n
        help
            Puts the chip to sleep (dwt_configuresleep() + dwt_entersleep())
            then pulses pin_wakeup high for 1ms, waits 100ms, and checks
            that dwt_readdevid() still reads back correctly. The sleep is
            configured to wake only on the WAKEUP pin (not on chip select),
            so a successful read is unambiguous evidence that WAKEUP itself
            did the waking.

            Default off: if WAKEUP *and* RSTn are both unwired or broken,
            recovering from a failed wake-up costs an extra hard-reset +
            re-probe cycle before the rest of the board bring-up checklist
            can continue running. Leave this off until RSTn (L4) has
            already been confirmed working on a new board.

endmenu
```
