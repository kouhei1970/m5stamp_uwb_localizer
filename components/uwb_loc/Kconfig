## firmware/tag/main/Kconfig.projbuild
```kconfig
menu "UWB Tag Configuration"

    choice UWB_TAG_BOARD
        prompt "ホストボード"
        default UWB_TAG_BOARD_STAMPS3
        help
            main.cpp が uwb::Qm33120 の設定に使うピン定義
            （リポジトリ直下の boards/stamps3.h / boards/atoms3.h /
            boards/stampfly.h）を選ぶ。

        config UWB_TAG_BOARD_STAMPS3
            bool "M5StampS3A"

        config UWB_TAG_BOARD_ATOMS3
            bool "M5 AtomS3"

        config UWB_TAG_BOARD_STAMPFLY
            bool "StampFly (M5StampS3A on drone, rear 12P FPC)"
            help
                M5StampS3A 背面に予約されている 12P FPC (0.5mm) 経由で
                接続する構成。SPI 4線に加えて RST / IRQ / WAKEUP がすべて
                取れる (boards/stampfly.h)。電源も同じコネクタの VDD_3V3
                から取るので降圧回路は要らない。
                旧 GROVE 4線構成は廃案 (2026-08-22)。

    endchoice

    choice UWB_BOARD_ATOMS3_PINOUT
        prompt "AtomS3 のピン構成"
        depends on UWB_TAG_BOARD_ATOMS3
        default UWB_BOARD_ATOMS3_PINOUT_A
        help
            boards/atoms3.h が生成するピン構成を2通りから選ぶ
            (docs/IRQ_POLICY.md)。構成Aは Grove ポート(G1/G2)を RST/IRQ に
            転用し、ToF は底面ヘッダ(G38/G39)へ手配線する構成で、G38/G39が
            オンボードの MPU6886 IMU と共用になる無印 AtomS3 向け。
            構成Bは底面ヘッダ(G38/G39)を RST/IRQ に使い、ToF は Grove に
            挿すだけで済む構成で、G38/G39 に何も繋がっていない AtomS3R 向け。

        config UWB_BOARD_ATOMS3_PINOUT_A
            bool "構成A: RST/IRQ=Grove(G1/G2), ToF I2C=G38/G39（底面へ手配線）"

        config UWB_BOARD_ATOMS3_PINOUT_B
            bool "構成B: RST/IRQ=G38/G39, ToF I2C=Grove(G1/G2)（Grove に挿すだけ）"

    endchoice

    choice UWB_TAG_METHOD
        prompt "測距方式"
        default UWB_TAG_METHOD_DS
        help
            SS-TWR (requestRange()): Poll/Response の1往復。距離はTag側で計算。
            DS-TWR (requestDSRange()): さらにFinal/Result往復が加わり、距離は
            Anchor側で計算されTagへ返送される。firmware/anchor 側の設定
            （firmware/anchor/main/Kconfig.projbuild）と必ず同じ方式にすること。
            既定はDS-TWR（本プロジェクトの本番運用の判断。SS-TWRよりクロック
            ドリフトの影響を受けにくい代わりに、アンカーあたり往復が1回増える）。

        config UWB_TAG_METHOD_SS
            bool "SS-TWR"

        config UWB_TAG_METHOD_DS
            bool "DS-TWR"

    endchoice

    config UWB_TAG_PER_ANCHOR_INTERVAL_MS
        int "同一周内でアンカーへの測距を始める間隔の最小値 [ms]"
        range 0 5000
        default 0
        help
            uwb::SchedulerConfig::perAnchorIntervalMs に渡す値。0なら前の
            アンカーの測距が終わり次第すぐ次へ進む（最速）。R6（更新レート）
            の実測・調整のためにあえて間隔を空けたい場合に上げる
            （docs/PLAN.md 参照）。

    config UWB_TAG_CYCLE_INTERVAL_MS
        int "1周終えてから次の周を始めるまでの間隔の最小値 [ms]"
        range 0 60000
        default 0
        help
            uwb::SchedulerConfig::cycleIntervalMs に渡す値。0なら前の周の
            ポーリングが終わり次第すぐ次の周を始める。下流の消費側の
            想定周期に合わせて意図的に更新レートを抑えたい場合に上げる。

    config UWB_TAG_RETRY_MAX
        int "1台のアンカーへの測距が失敗したときの即時再試行回数"
        range 0 4
        default 2
        help
            uwb::SchedulerConfig::retryMax に渡す値。0なら1回試行して失敗
            したらそのままスキップする（従来の挙動）。1以上にすると、
            最初の試行が失敗したアンカーに対し、同じ周のうちにこの回数まで
            再試行する（試行ごとに UWB_TAG_RETRY_DELAY_MS だけ待つ）。1台
            あたりの最大試行回数は 1+この値 になる。

            実測根拠（firmware/twr、UWB_TWR_RETRY_MAX=2、
            docs/HANDOFF.md §0-C「再試行系列」「再試行の待ち時間」）:
            850kbpsでSS-TWR/DS-TWRとも周期成功率99.9%まで上がった
            （DS-TWRはUWB_TAG_RETRY_DELAY_MSを適切な値にした場合）。

            サイクル時間への影響（最悪ケース、1台あたり）: 最大
            (1+この値) × (ホストのタイムアウト + UWB_TAG_RETRY_DELAY_MS)。
            既定値（この値=2、DS-TWRのホストタイムアウト約20ms、
            RETRY_DELAY_MS=10ms）なら 3 × 30ms = 90ms/台。ただし再試行が
            発生するサイクル自体が全体の1〜2割程度しかないため、平均への
            影響は+1.2ms/アンカー程度にとどまる（同節の実測）。

    config UWB_TAG_RETRY_DELAY_MS
        int "再試行のPoll送信前に追加で待つ時間 [ms]"
        range 0 100
        default 2
        help
            uwb::SchedulerConfig::retryDelayMs に渡す値。
            UWB_TAG_RETRY_MAX=0 のときは使われない。

            【2026-08-30 v2 アンカー（uwb::Responder、受信常時 ON）での実測】
            850kbps/256・PollingBoth・DS・約1.2m・95秒: 待ち 0ms で周期成功率 99.0%
            （2回目の試行の失敗率 28%）、2ms で 99.5%（15%、周期の p95 17ms）、
            10ms で 99.6%（9%、p95 26ms）。v2 アンカーは Final 待ち中の Poll に
            応じ、Response 送信直後から受信するので、SS/DS とも既定 2ms で足りる。
            10ms は周期時間を延ばすだけで成功率は誤差の範囲。

            以下は旧アンカー（firmware/twr の respondDSRange()、200ms 窓）で
            測った記録で、旧アンカーと組む場合にだけ当てはまる:

            旧アンカーの DS-TWR では**10ms以上が必須**だった: アンカーは自身のResponse送信後、
            次のFinalを待つ窓（850kbps/256・PollingBothプリセットで
            Response遅延3000UUS + W4R（Wait-for-Response）1500UUS +
            RXタイムアウト3000UUS、合わせてPoll受信からおよそ+8.2msまで）の
            中にいる間は再試行のPollを聞いていない。即時再試行（0ms）だと
            2回目の試行の失敗率が39〜44%だったのに対し、10ms待つと12%まで
            下がり、周期成功率は96%台から99.9〜100%へ上がった
            （docs/HANDOFF.md §0-C「再試行の待ち時間」e37〜e41、
            UWB_TWR_RETRY_MAX=2実測）。

            SS-TWRでは待ちは不要: Response待ち失敗の時点でアンカーは既に
            Poll待ちへ戻っているため、2msの短い間隔だけで2回目の失敗率
            7.5%（独立試行相当。同節e34）。

    config UWB_TAG_STATS_INTERVAL_MS
        int "測距成功率(\"type\":\"stats\")行を出す間隔 [ms]（0で出力しない）"
        range 0 60000
        default 1000
        help
            uwb::RangingScheduler::stats() が持つ「どのアンカーが悪いか」の
            成功率統計を、毎周期の "type":"fix" 行とは別に "type":"stats"
            行としてこの間隔で出す(docs/HANDOFF.md §5 タスクE)。fix は
            毎周期（約31Hz）出るため、そこへ成功率を足すとログが太る。
            JsonLinesHal（third_party/uwb_localizer 側）は未知のtypeを
            読み捨てるので互換性は安全（本ファイル冒頭コメント参照）。

            0 にすると stats 行そのものを出さない（従来どおり fix/meas/
            anchors のみ）。

    config UWB_TAG_SERVICE_TASK_CORE
        int "uwb_ranging_svc タスク（測距・測位を回す唯一のタスク）を割り当てるコア"
        range 0 1
        default 1
        help
            uwb::RangingService::start() が xTaskCreatePinnedToCore() へ渡す
            コア番号（docs/ARCHITECTURE_V2.md §3.1/§3.2）。電波（UWBチップ）を
            触るのはこのタスクだけ。既定は 1（コア0はコンソール REPL と
            uwb_log タスクに譲る）。

    config UWB_TAG_SERVICE_TASK_PRIO
        int "uwb_ranging_svc タスクの優先度"
        range 1 24
        default 18
        help
            uwb::RangingService::start() が xTaskCreatePinnedToCore() へ渡す
            優先度。無線の応答待ち（W4R/RXタイムアウト等）に遅れが出ないよう、
            他の常駐タスク（コンソール REPL・uwb_log。後者は既定 prio=10 固定、
            main.cpp の kLogTaskPrio）より高く設定してあること。

    config UWB_TAG_SERVICE_TASK_STACK
        int "uwb_ranging_svc タスクのスタックサイズ [bytes]"
        range 4096 32768
        default 8192
        help
            uwb::RangingService::start() が xTaskCreatePinnedToCore() へ渡す
            スタックサイズ。このタスクは RangingScheduler::runCycle()
            （TWR往復）と PositioningPipeline::solve()/updateEkf()（Lv0/Lv2/
            EKFソルバ）を毎周期呼ぶ — v1 では app_main のタスクスタック
            （CONFIG_ESP_MAIN_TASK_STACK_SIZE、sdkconfig.defaults で12288に
            引き上げ済み。理由は9x9 double行列を積むEKF連鎖 約3.5KB +
            Lv0/Lv2経路 約2KB。docs/REVIEW_2026-08-21.md §0 #3参照）で
            発生していたのと同じ呼び出し連鎖がこちらに移った。

            **未測定**（実機が無いため計測できていない）: 上のv1実測の内訳
            （EKF連鎖3.5KB + Lv0/Lv2 2KB ≈ 5.5KB）に、TWR往復自体のローカル
            変数・呼び出しフレーム（Qm33120::requestDSRange() 等、SPI/IRQ
            待ちを含む）の見積り分を足して8192を既定にした。5秒後の
            uxTaskGetStackHighWaterMark() ログ（uwb_log タスクが出す）で
            実測し、2KB未満ならこの値を上げること。

    config UWB_TAG_LOG_TASK_STACK
        int "uwb_log タスク（JSON Lines出力・診断ログ）のスタックサイズ [bytes]"
        range 4096 32768
        default 6144
        help
            main.cpp が起こす uwb_log タスク（コア0固定、優先度は
            uwb_ranging_svc より低い固定値10）のスタックサイズ。
            JSON整形用の2KBバッファ（g_jsonBuf）自体は .bss 上に置いてあり
            タスクスタックは消費しないが、printf系（vsnprintf/fputs）の
            内部フレームと、旧コンソールの `replCfg.task_stack_size=6144`
            （anchor list が1行あたり4個の浮動小数点をprintfする分の余裕を
            見て設定されていた値）を参考に、同じ6144を既定にした。

            **未測定**（実機が無いため計測できていない）。5秒後の
            uxTaskGetStackHighWaterMark() ログで実測し、2KB未満ならこの値を
            上げること。

    config UWB_TAG_CONSOLE
        bool "シリアルコンソール (USB-Serial/JTAG) を有効にする"
        default y
        help
            有効にすると、起動時に ESP-IDF の console コンポーネント
            (linenoise + argtable3) による REPL を専用タスクで立ち上げ、
            USB 経由で次のコマンドを受け付ける。

                anchor list
                anchor set <idx> <hex_addr> <x> <y> <z>
                anchor delay <idx> <meters>
                anchor enable <idx> / anchor disable <idx>
                anchor count <n>
                mode [auto|2d|3d]   （測位モードの表示・手動切替）
                height [<meters>]   （2D測位の固定高さの表示・変更）
                output <on|off>   （JSON Lines 出力の一時停止）
                save / reset-config / info / reboot

            これにより「アンカー座標を数cm直すたびに再ビルド・再書き込み」が
            不要になる (docs/GETTING_STARTED.md §7)。

            コンソールは測位ループとは別タスクで動き、編集内容は次の測位周期
            の先頭で取り込まれる（実装方針は main/tag_console.hpp の冒頭
            コメントを参照）。

            無効にすると tag_console.cpp 自体がビルド対象から外れ、console
            コンポーネントへの依存も消える。NVSに保存済みのテーブルで起動する
            機能だけは残るので、「コンソールで設定して save したあと、
            コンソールを無効にしたファームを焼く」運用もできる。

    config UWB_TAG_ENABLE_EKF
        bool "測距1本ごとに逐次 Lv3 EKF (uwb_ekf) を更新する"
        default y
        help
            有効にすると、Lv0/Lv2の呼び出しと同じ単一タスク（測距を回す
            uwb_ranging_svcタスク）から uwb::PositioningPipeline::updateEkf()
            を呼ぶ（uwb_ekf はスレッド安全でないため。
            uwb_ranging_pipeline.hpp 参照）。

            呼び出しは周期末尾でまとめて1回ではなく、**測距1本が成功する
            たびに逐次**行う（uwb::RangingScheduler::setSampleHook() で
            登録したフックが runCycle() の内側で同期的に呼ぶ。
            uwb_ranging_scheduler.hpp の RangingSampleHook / uwb_ranging_
            service.hpp の onRangingSample() 参照）。各距離をその距離が
            実際に測られた時刻（RangingSample::t_us）で処理できるため、
            1周期の間に台数ぶん測距時刻がずれる（同一周でも台ごとに
            最大で1周の所要時間ぶん差が出る）動くタグでの追従精度が
            向上する。

            JSON Linesのfixログには従来どおりLv3のセクションと計算時間
            (solve_us_lv3、逐次更新の合計) が追加される。既定は有効
            （逐次更新方式への切り替えに伴い、本番運用でのLv3有効化を
            既定にした）。

    config UWB_TAG_FIXED_Z_MM
        int "2D測位（dim=2固定）で使う高さの既定値 [mm]"
        range -10000 10000
        default 1200
        help
            uwb::AnchorTable::evaluateMode()（components/uwb_ranging/include/
            uwb_ranging_mode.hpp）が測位モードを2D（RangingModeがMode2D）に
            決めたときに使う固定高さ z_fixed の既定値。以下のいずれかで
            2Dになったときに使われる:
              - 有効アンカーが3台ちょうど
              - 有効アンカーが4台以上だが全て同一平面上にある
                （3D測位が原理的に不安定/失敗するため自動フォールバック）
              - `mode 2d` コンソールコマンドで手動指定
            ワールド座標系でのタグの想定運用高さを設定すること。

            起動時の既定値としてのみ使う。実行時はタグのコンソール
            （firmware/tag/main/tag_console.cpp）の `height <メートル>` で
            上書きでき、`save` で NVS へ永続化できる。NVSに保存済みの値が
            あれば起動時はそちらを優先する（この設定はNVSが空のときの
            フォールバック）。

    choice UWB_TIMING_PROFILE
        prompt "TWR 遅延プリセット"
        default UWB_TIMING_PROFILE_POLLING_BOTH
        help
            docs/TIMING_PRESETS.md で確定した、役割(タグ/アンカー) × IRQ有無の
            組み合わせごとの遅延パラメータ一式（応答遅延・受信タイムアウト等）
            を切り替える。

            **タグとアンカーは必ず同じプリセットを選ぶこと。** 片側だけ変える
            と測距が成立しない。しかも症状は「距離が出ない」だけでどちらが
            悪いのかログからは分からないため、フレーム(Poll/Response)に
            版番号と種別を載せて相手と比較し、不一致なら警告する仕組みが
            入っている（測距自体は続行する。docs/TIMING_PRESETS.md §3）。

            この設定値は自動では変わらない。例えば BothIrq を選んでも
            タグの pin_irq が未配線で待ちがポーリングへフォールバックした
            場合、遅延の値自体は変えず、起動ログで警告するだけになる
            （docs/TIMING_PRESETS.md §4(b)）。

        config UWB_TIMING_PROFILE_POLLING_BOTH
            bool "両側ポーリング（**既定**。850kbps向けに実機で検証済み。docs/HANDOFF.md §0-D）"

        config UWB_TIMING_PROFILE_ANCHOR_IRQ
            bool "アンカーのみ IRQ（約59Hz、6.8Mbps/128前提。850kbpsでは未検証・未再導出）"

        config UWB_TIMING_PROFILE_BOTH_IRQ
            bool "両側 IRQ（約90Hz、6.8Mbps/128前提。850kbpsでは未検証・未再導出）"

    endchoice

    config UWB_ENABLE_IRQ
        bool "IRQ を起床信号として使う（未配線なら自動でポーリングへフォールバック）"
        default y
        help
            IRQ（割り込み要求）を、受信を待つループの「起床信号」としてだけ
            使う。ステータスレジスタの判読・フレーム照合・エラー処理は
            IRQ有効/無効に関わらず完全に同一のポーリング経路を通る
            （dwt_setcallbacks()/dwt_isr()は使わない。docs/IRQ_POLICY.md）。

            タグは標準構成（StampFly、GROVE 4本をSPIに使い切る）では
            IRQ 線が残らずポーリングで成立させる方針であり、単体
            M5StampS3A/AtomS3 でタグを組む場合のみ pin_irq が配線される。
            いずれの場合も実機での極性検証がまだ済んでいないため既定は
            n（無効）にしてある。

            有効にしても pin_irq が未配線（StampFly構成）、または ISR
            登録に失敗した場合は自動的にポーリングへフォールバックする
            （`uwb::Qm33120::irqActive()` で実際に有効になったかを確認
            できる。起動ログにも出る）。ポーリング経路は常に第一級の
            実装として残っており、劣化版ではない。

endmenu
```
