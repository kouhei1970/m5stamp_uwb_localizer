## components/uwb_loc/Kconfig
```kconfig
menu "uwb_loc (測位ソルバ) Configuration"

    config UWB_LOC_MAX_ANCHORS
        int "同時に扱えるアンカー数の上限 (UWB_MAX_ANCHORS)"
        range 4 16
        default 8
        help
            uwb_loc.h の UWB_MAX_ANCHORS を上書きする。アンカー座標配列や
            観測バッファなど、静的に確保する領域の大きさに影響する
            （台数を絞るほど RAM を節約できる）。

            本プロジェクトの運用構成はアンカー4〜8台想定
            （docs/PLAN.md の「運用構成」参照）であり、取り込み元の既定値
            16 のままだと使わない分の RAM を無駄に確保してしまう。そのため
            既定値は 8 とする。

            なお実際に静的配列のサイズへ効くのは主に UWB_MAX_MEAS
            （1エポックの観測数上限）側で、UWB_MAX_ANCHORS はアンカー配列
            自体の確保を呼び出し側に委ねている（uwb_config.anchors は
            借用のみでライブラリ側はコピーしない）ため、この値そのものは
            サンプルコード（examples/03_replay.c 等）が固定長配列を
            確保する際の目安として使われる。アンカー台数を増やす予定が
            あるなら、この値も合わせて引き上げること。

    config UWB_LOC_MAX_MEAS
        int "1エポックあたりの観測数上限 (UWB_MAX_MEAS)"
        range 4 32
        default 8
        help
            uwb_loc.h の UWB_MAX_MEAS を上書きする。Lv0〜Lv2 の残差・
            ヤコビアン・重みなどの作業配列や、EKF の立ち上げ待ちバッファの
            大きさに直接効く（スタック使用量に最も影響するパラメータ）。

            1エポックの観測数はアンカー台数と概ね一致するので、
            UWB_LOC_MAX_ANCHORS と同じ値（既定 8）にしておけば十分。

    config UWB_LOC_ID_LEN
        int "アンカーIDの文字列長 (UWB_ID_LEN、終端含む)"
        range 1 32
        default 16
        help
            uwb_loc.h の UWB_ID_LEN を上書きする。uwb_anchor.id の
            文字列バッファ長（終端 NUL を含む）。ID を使わず添字だけで
            アンカーを識別するなら 1 まで縮めてよい。

    config UWB_LOC_USE_FLOAT
        bool "uwb_real を float にする (UWB_USE_FLOAT)"
        default n
        help
            uwb_loc.h の UWB_USE_FLOAT を有効にし、uwb_real を double から
            float に切り替える。ROM/RAM は節約できるが、取り込み元
            third_party/uwb_localizer/c/README.md が明記している通り、
            Beck法（uwb_beck_gtrs、Lv2 の初期値作りに使う）の二分法や
            共分散の計算は有効桁が少ない float だと桁落ちしやすい。

            そのため既定は OFF（double のまま）とする。float 化を試すのは、
            まず double で測位精度・EKFの追従を検証してから、ROM/RAM が
            本当に足りない場合の最終手段とすること。

endmenu
```

## components/uwb_net/Kconfig
```kconfig
# components/uwb_net 共通 Kconfig
#
# ESP-IDF はコンポーネントディレクトリ直下の `Kconfig` を自動的に取り込み、
# "Component config" メニューの下に出す（firmware/*/main/Kconfig.projbuild
# 側から include する必要は無い。components/uwb_qm33120/Kconfig と同じ流儀）。

menu "UWB Network (Wi-Fi dashboard)"

    config UWB_NET_ENABLE
        bool "Enable uwb_net (Wi-Fi + browser dashboard + remote console)"
        default y
        help
            n にすると uwb_net.hpp の公開関数
            (start/publishLine/isStarted/registerConsoleCommands) はすべて
            no-op になり、Wi-Fi・HTTP・UDP・TCP コンソールを一切起動しない
            （scratchpad/NET_SPEC.md §7）。フラッシュ書き込みは既存の
            USB-Serial/JTAG シリアルコンソールと JSON Lines 出力のみで運用
            したい場合や、Wi-Fi 由来の消費電力・干渉を避けたい場合に使う。

    # 以下のオプションはあえて "depends on UWB_NET_ENABLE" を付けていない:
    # UWB_NET_ENABLE=n でも CONFIG_UWB_NET_* の #define 自体は常に生成されて
    # いてほしい（firmware/tag, firmware/anchor の main.cpp は uwb_net.hpp の
    # 設計方針どおり #if で分岐せず常に同じコードを書くため、これらの値を
    # 無条件に参照する。ENABLE=n のときは値そのものが使われないだけ）。

    config UWB_NET_AP_PASSWORD
        string "SoftAP password"
        default "uwb-localizer"
        help
            NVS に有効な Wi-Fi 認証情報が無い場合（買ったばかり、または
            "wifi clear" 実行後）に立ち上げる SoftAP の WPA2 パスワード。
            SSID は機体名（"uwb-tag" / "uwb-anchor-XXXX"）そのもの。

    config UWB_NET_AP_CHANNEL
        int "SoftAP channel"
        range 1 13
        default 1
        help
            SoftAP のチャネル。UWB（ch9, 3.5〜6.5GHz 帯の一部を含む UWB
            チャネル）とは周波数帯が異なる 2.4GHz Wi-Fi なので、UWB 測距へ
            の直接の干渉は無い。

    config UWB_NET_HTTP_PORT
        int "HTTP port"
        range 1 65535
        default 80
        help
            ブラウザ用ダッシュボード（"/"）と WebSocket（"/ws"）を出す
            ポート。

    config UWB_NET_CONSOLE_PORT
        int "TCP console port"
        range 1 65535
        default 23
        help
            USB を挿さずに Wi-Fi 経由でシリアルコンソール相当の操作をする
            ための平文 TCP コンソール（1 クライアントのみ）。

    config UWB_NET_UDP_PORT
        int "UDP broadcast/aggregate port"
        range 1 65535
        default 5006
        help
            アンカー（forward=true）がこのポートへ JSON Lines を
            ブロードキャストし、タグ（aggregate=true）がこのポートで
            受信して自分の配信へ混ぜる。

    config UWB_NET_HIGHRATE_MIN_INTERVAL_MS
        int "High-rate line decimation interval [ms]"
        default 50
        help
            "meas" / "fix" / "range" 行をネットワーク側へ配信する最短間隔。
            0 だと間引きなし（UWB 側の生の頻度のまま、~100Hz でブラウザ・
            UDP・TCP へ流れる）。USB シリアルの JSON Lines 出力そのものは
            この設定の影響を受けない（間引きは publishLine() の中、
            つまりネットワーク側だけの経路にのみ掛かる）。

    config UWB_NET_RING_BYTES
        int "Line ring buffer size [bytes]"
        default 12288
        help
            配信待ちの JSON Lines を溜めるリングバッファのサイズ。溢れた
            行は捨てられ "node" 行の "drops" に計上される（ブロックはしない）。

    config UWB_NET_MDNS
        bool "Enable mDNS (<name>.local)"
        default y
        help
            n にすると mDNS を起動しない（IP アドレス直打ちでのみ
            ダッシュボードへアクセスできる）。

endmenu
```

## components/uwb_qm33120/Kconfig
```kconfig
# components/uwb_qm33120 共通 Kconfig (docs/ARCHITECTURE_V2.md §4)
#
# ESP-IDF はコンポーネントディレクトリ直下の `Kconfig` ファイルを自動的に
# 取り込み、"Component config" メニューの下に出す（このファイルを
# firmware/*/main/Kconfig.projbuild 側から include する必要は無い）。
# uwb_qm33120 を REQUIRES するファーム（firmware/anchor, firmware/tag,
# firmware/twr）ならどれでもこのメニューが出る。
#
# これは PHY（データ速度・プリアンブル長・送信電力・PGdelay・PLL粗調整）を
# 個別ファームの DIAG_* オプションとしてではなく、tag/anchor/twr で共通に
# 選べるようにするための本番向けオプション。firmware/twr の DIAG_PHY_* /
# DIAG_TXPOWER / DIAG_PGDELAY / DIAG_PLL_COARSE_CH9 (main/Kconfig.projbuild)
# と対応するが、twr 側は既存の DIAG_* のまま維持する（本ファイルの追加が
# twr の挙動を変えることは無い）。
#
# uwb::phyConfigFromKconfig()（uwb_qm33120_phy_kconfig.hpp/.cpp）がこれらの
# 値を uwb::PhyConfig へ変換する。

menu "UWB PHY (uwb_qm33120)"

    choice UWB_PHY_DATA_RATE
        prompt "Data rate"
        default UWB_PHY_DATA_RATE_850K
        help
            uwb::PhyConfig::dataRate。既定は 850 kbps（2026-08-30 の実機比較で
            選定: 約 1.2 m 卓上で DS の素の成功率が 6.8 Mbps/128 の 40%、
            6.8 Mbps/1024 の 75% に対し 850 kbps/256 で 86〜90%。6.8 Mbps は
            プリアンブルを伸ばさないと捕捉できず、伸ばすと周期が 850 kbps/256
            より遅くなるため、この機材では速度の利点が無い。docs/HANDOFF.md
            §0-C「§G」参照）。6.8 Mbps は M5Stamp UWB Module の出荷時既定値
            （uwb_qm33120_types.hpp PhyConfig::dataRate）。タグ・アンカー双方を
            同じ値で焼くこと（片側だけ変えると測距が成立しない）。

        config UWB_PHY_DATA_RATE_6M8
            bool "6.8 Mbps (モジュール出荷時の値)"

        config UWB_PHY_DATA_RATE_850K
            bool "850 kbps (既定、2026-08-30 実測で選定)"

    endchoice

    config UWB_PHY_PREAMBLE_LEN
        int "Preamble length (symbols): 64 / 128 / 256 / 512 / 1024"
        default 256
        help
            uwb::PhyConfig::preambleLength。有効な値は 64 / 128 / 256 / 512 /
            1024 のみ（Kconfig の int 型は離散値の列挙を表現できないため、
            範囲外の値は uwb::phyConfigFromKconfig() が実行時に警告して
            128 (PAC8) へフォールバックする。firmware/twr の
            UWB_TWR_DIAG_PHY_PREAMBLE と同じ制約）。

            PAC（Preamble Acquisition Chunk）サイズは Qorvo 推奨規則で
            プリアンブル長から自動的に決まる（docs/ARCHITECTURE_V2.md §4）:
                64, 128  -> PAC8
                256, 512 -> PAC16
                1024     -> PAC32

            タグ・アンカー双方を同じ値で焼くこと。

    config UWB_PHY_TX_POWER
        hex "TX_POWER register value (0xfefefefe = ch9 の Qorvo 既定)"
        range 0x00000000 0xffffffff
        default 0xfefefefe
        help
            uwb::PhyConfig::txPower。DW3720 の TX_POWER レジスタへそのまま
            書き込まれる値（4バイト = TX_CP_PWR(STS)/TX_SHR_PWR/TX_PHR_PWR/
            TX_DATA_PWR、上位バイトから順。deca_device_api.h dwt_txconfig_t
            のコメント参照）。0xfefefefe は Qorvo リファレンス設計の ch9
            最大値。firmware/twr の UWB_TWR_DIAG_TXPOWER と同じ意味。

    config UWB_PHY_PG_DELAY
        hex "TX pulse-generator delay / PGdly (0x34 = ch9 の Qorvo 既定)"
        range 0x00 0x3F
        default 0x34
        help
            uwb::PhyConfig::pgDelay。DW3720 の TX_CTRL_HI PG_DELAY
            フィールドへ dwt_configuretxrf() 経由で書き込まれる、送信パルス
            発生器の遅延（送信パルス帯域幅を決める）。0x34 は Qorvo
            リファレンス設計の ch9 既定値。firmware/twr の
            UWB_TWR_DIAG_PGDELAY と同じ意味。

    choice UWB_PHY_PLL_COARSE_MODE
        prompt "Ch9 PLL VCO coarse-tune code source"
        default UWB_PHY_PLL_COARSE_MODE_OTP
        help
            2026-08-30 実機結果: 本番既定 (850kbps/256, PollingBoth, IRQ) +
            UWB_PHY_PLL_COARSE_CH9=0（チップの自動校正まかせ）のベンチ実行
            (e66) は初回試行成功率 p=50.1%（周期成功率86.8%）だったのに対し、
            同一構成で PLL 粗調整コードを 0x23 に固定した実行 (e56) は
            p=90%（周期成功率99.0%）だった。docs/HANDOFF.md §0-B の実測:
            チップの自動 PLL 粗調整はブート時のダイ温度に応じて 0x23 または
            0x24 のどちらかに着地し、OTP にはこの基板向けに書き込まれた値
            0x0B001F23（ch9 粗調整フィールド bits[6:0] = 0x23）が入っている
            （firmware/twr の起動ログ otp_pll_cc= と同じ値、
            uwb::Qm33120::logCal() 参照）。0x23 固定はこの2枚の基板では
            効いたが、他基板では OTP の値が違いうるためハードコードは
            危険 - 個体ごとに正しい値を機械的に選べる OTP モードを既定にする。

            Real-hardware finding (2026-08-30): production defaults
            (850kbps/256, PollingBoth, IRQ) with UWB_PHY_PLL_COARSE_CH9=0
            (chip auto-calibration) measured first-attempt p=50.1% (cycle
            86.8%); the identical config with the coarse code forced to
            0x23 measured p=90% (cycle 99.0%). docs/HANDOFF.md §0-B: the
            chip's auto PLL coarse calibration lands on 0x23 or 0x24
            depending on boot-time die temperature, while OTP holds the
            board-programmed value (0x0B001F23 on these two boards, i.e.
            ch9 coarse-tune field bits[6:0] = 0x23). A hard-coded 0x23 is
            board-specific and unsafe for other units, so the default here
            reads the per-board OTP value instead.

        config UWB_PHY_PLL_COARSE_MODE_AUTO
            bool "Auto (chip's own hardware PLL calibration - old default)"

        config UWB_PHY_PLL_COARSE_MODE_OTP
            bool "OTP (read this board's coarse code from OTP - default)"

        config UWB_PHY_PLL_COARSE_MODE_FIXED
            bool "Fixed (force UWB_PHY_PLL_COARSE_CH9 below - single-board diagnostics only)"

    endchoice

    config UWB_PHY_PLL_COARSE_CH9
        hex "Force ch9 PLL VCO coarse-tune code (only used when Fixed is selected above)"
        depends on UWB_PHY_PLL_COARSE_MODE_FIXED
        range 0x00 0x7F
        default 0x00
        help
            UWB_PHY_PLL_COARSE_MODE=Fixed のときだけ使う、ch9 の PLL VCO
            粗調整コード（PLL_COARSE_CODE レジスタの ch9 フィールド、
            bits[6:0]）の直接指定値。begin() 成功直後に
            uwb::Qm33120::forcePllCoarse() を呼び、生レジスタ操作で PLL を
            再ロックする。個体ごとに OTP の値が違いうるため、通常は Fixed
            ではなく既定の OTP モードを使うこと - Fixed は特定の1台だけを
            狙った切り分け（例: OTP が壊れている個体の代替、他コードでの
            実験）向け。

            手順そのものは uwb::Qm33120::forcePllCoarse()
            （components/uwb_qm33120/src/uwb_qm33120_phy_kconfig.cpp）に
            移植してあり、firmware/twr は引き続き自前のコピー（main.cpp の
            diagForcePllCoarseCh9()、Kconfig オプション
            UWB_TWR_DIAG_PLL_COARSE_CH9）を使う（本メニューの選択は
            firmware/twr の挙動に影響しない）。

endmenu
```
